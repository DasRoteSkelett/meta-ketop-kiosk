## conf/layer.conf
```bitbake
# We have a conf and classes directory, add to BBPATH
BBPATH .= ":${LAYERDIR}"

# We have recipes-* directories, add to BBFILES
BBFILES += "${LAYERDIR}/recipes-*/*/*.bb \
            ${LAYERDIR}/recipes-*/*/*.bbappend"

BBFILE_COLLECTIONS += "meta-ketop-kiosk"
BBFILE_PATTERN_meta-ketop-kiosk = "^${LAYERDIR}/"
BBFILE_PRIORITY_meta-ketop-kiosk = "6"

LAYERDEPENDS_meta-ketop-kiosk = "core"
LAYERSERIES_COMPAT_meta-ketop-kiosk = "hardknott honister"
```
